## lib/job_scheduler/Kconfig
```kconfig
menu "Job Scheduler"

config JOB_SCHEDULER
    bool "Enable cooperative job scheduler"
    default y
    depends on ASYNC
    help
      A lightweight cooperative scheduler that multiplexes multiple async
      coroutines inside a single RTOS task.

      Each job is a coroutine (async_fn_t) that yields cooperatively via
      ASYNC_YIELD / ASYNC_AWAIT.  On every vibe_sched_run() call:

        1. All READY jobs run once in descending priority order.
        2. All BLOCKED jobs are re-probed (their ASYNC_AWAIT condition
           is re-evaluated).

      Completed jobs (ASYNC_DONE) are freed back to the pool automatically.
      Use vibe_sched_is_idle() to decide when to yield the RTOS task.

config JOB_SCHEDULER_MAX_JOBS
    int "Maximum number of concurrent jobs per scheduler"
    default 8
    range 1 64
    depends on JOB_SCHEDULER
    help
      Static pool size for job slots.  Each vibe_job_sched_t instance
      allocates this many vibe_job_t entries.  Jobs submitted when the
      pool is full are rejected (vibe_sched_submit returns NULL).

      Size of one vibe_job_t (with stats disabled):
        arm-none-eabi -O2:  ~24 bytes per slot
      Total pool:           MAX_JOBS × ~24 bytes in BSS/data.

config JOB_SCHEDULER_STATS
    bool "Enable job scheduler statistics"
    default n
    depends on JOB_SCHEDULER
    help
      Adds aggregate counters to every vibe_job_sched_t:
        submitted  — total jobs ever submitted
        completed  — total jobs that returned ASYNC_DONE
        active     — currently occupied (non-idle) slots
        ticks      — total vibe_sched_run() calls

      Also adds a per-job run_count field (times each job was resumed).
      Retrieve with vibe_sched_get_stats(sched, &stats).
      Adds ~16 bytes overhead per scheduler instance.

endmenu
```

## lib/ring_buffer/Kconfig
```kconfig
menu "Ring Buffer"

config RING_BUFFER
    bool "Enable ring buffer support"
    default y
    help
      Enables the SPSC (single-producer / single-consumer) lock-free ring
      buffer (vibe_rb_t). Used by the UART driver and the shell subsystem.
      Disable to exclude the ring buffer entirely and save flash.

config RING_BUFFER_STATS
    bool "Enable ring buffer statistics"
    default n
    depends on RING_BUFFER
    help
      Adds per-instance statistics counters to every vibe_rb_t:
        peak_used   — peak occupancy ever observed (bytes)
        put_count   — total bytes successfully written
        get_count   — total bytes successfully read
        drop_count  — bytes dropped because the buffer was full

      Retrieve with vibe_rb_get_stats(rb, &s).
      Reset with vibe_rb_reset_stats(rb).

      Cost: 4 × size_t (~16 bytes) per ring buffer instance plus a few
      counter increments on every put/get call.

endmenu
```

## soc/arm/raspberrypi/rp2040/Kconfig.soc
```kconfig
config SOC_RP2040
    bool "Raspberry Pi RP2040"
    select CPU_CORTEX_M0PLUS
    help
      RP2040 dual-core Cortex-M0+ SoC by Raspberry Pi Ltd.
      Used on the Raspberry Pi Pico board.

if SOC_RP2040

config SOC_HAS_FPU
    bool
    default n

config SOC_FLASH_SIZE
    int
    default 2097152  # 2MB (external QSPI flash, not on-die)

config SOC_RAM_SIZE
    int
    default 270336   # 264KB SRAM (6 banks: 4x16K + 2x4K)

config SOC_NUM_CORES
    int
    default 2        # Dual-core Cortex-M0+

endif # SOC_RP2040
```
