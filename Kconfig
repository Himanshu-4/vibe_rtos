## Kconfig
```kconfig
# VibeRTOS Top-level Kconfig
# This is the root Kconfig file. All subsystem Kconfigs are sourced from here.

mainmenu "VibeRTOS Configuration"

# Source architecture Kconfig
source "arch/Kconfig"

# Source kernel Kconfig
source "kernel/Kconfig"

# Source drivers Kconfig
source "drivers/Kconfig"

# Source subsystems Kconfig
source "subsys/Kconfig"

# Source library Kconfig (heap, ring buffer)
source "lib/Kconfig"

# Top-level board/SoC selection helpers
config BOARD
    string "Board name"
    default "rpi_pico"
    help
      The name of the board being targeted. This selects the board-specific
      Kconfig and device tree files.

config SOC
    string "SoC name"
    default ""
    help
      The SoC name. Usually selected automatically by the board Kconfig.

config SYS_CLOCK_HZ
    int "System tick rate in Hz"
    default 1000
    range 100 10000
    help
      The system tick frequency in Hz. Higher values give finer timer
      resolution but increase interrupt overhead.
      Common values: 100, 250, 500, 1000.
```

## arch/Kconfig
```kconfig
# arch/Kconfig — Architecture selection

choice
    prompt "Target architecture"
    default ARCH_ARM

config ARCH_ARM
    bool "ARM"
    help
      ARM Cortex-M architecture (M0+, M33, M4, M55).
      Select the exact variant under "ARM Cortex-M variant".

endchoice

# Source the selected architecture's Kconfig
if ARCH_ARM
    source "arch/arm/Kconfig"
endif
```

## arch/arm/Kconfig
```kconfig
# arch/arm/Kconfig — ARM-specific options

menu "ARM Cortex-M variant"

choice
    prompt "Cortex-M core variant"
    default CPU_CORTEX_M0PLUS

config CPU_CORTEX_M0PLUS
    bool "Cortex-M0+"
    help
      ARMv6-M Cortex-M0+. No FPU. Used by RP2040 (Raspberry Pi Pico).
      Thumb-only instruction set.

config CPU_CORTEX_M33
    bool "Cortex-M33"
    help
      ARMv8-M Mainline Cortex-M33. Optional FPU, optional TrustZone.
      Used by RP2350 (Raspberry Pi Pico 2).

config CPU_CORTEX_M4
    bool "Cortex-M4"
    help
      ARMv7-M Cortex-M4 with optional FPU (Cortex-M4F).

config CPU_CORTEX_M55
    bool "Cortex-M55"
    help
      ARMv8.1-M Cortex-M55 with Helium (M-Profile Vector Extension).

endchoice

endmenu

source "arch/arm/cortex_m/Kconfig"
```

## arch/arm/cortex_m/Kconfig
```kconfig
# arch/arm/cortex_m/Kconfig — Cortex-M feature options

menu "Cortex-M features"

config HAS_FPU
    bool "CPU has a floating-point unit (FPU)"
    default n if CPU_CORTEX_M0PLUS
    default y if CPU_CORTEX_M33
    default y if CPU_CORTEX_M4
    default y if CPU_CORTEX_M55
    help
      Enable when the Cortex-M variant has an FPU (e.g., M4F, M33 with FPU).
      Enables saving/restoring FP registers on context switch.

config HAS_MPU
    bool "CPU has a Memory Protection Unit (MPU)"
    default n if CPU_CORTEX_M0PLUS
    default y if CPU_CORTEX_M33
    default y if CPU_CORTEX_M4
    default y if CPU_CORTEX_M55
    help
      Enable MPU support for memory region protection.

config HAS_TRUSTZONE
    bool "CPU has TrustZone (Secure/Non-Secure)"
    default n
    depends on CPU_CORTEX_M33 || CPU_CORTEX_M55
    help
      Enable TrustZone for ARMv8-M Mainline cores.
      Requires secure and non-secure world separation in the linker script.

config NVIC_PRIO_BITS
    int "Number of NVIC priority bits implemented"
    default 2 if CPU_CORTEX_M0PLUS
    default 3 if CPU_CORTEX_M33
    default 4 if CPU_CORTEX_M4
    default 3 if CPU_CORTEX_M55
    range 2 8
    help
      Number of priority bits in the NVIC PRIGROUP field.
      Determines the number of configurable interrupt priorities.

endmenu
```

## boards/arm/rpi_pico/Kconfig.board
```kconfig
config BOARD_RPI_PICO
    bool "Raspberry Pi Pico"
    select SOC_RP2040
    help
      Raspberry Pi Pico board based on the RP2040 microcontroller.
      Features: 2MB QSPI flash, USB, 26 GPIO pins, SWD debug.
```

## boards/arm/rpi_pico/rpi_pico_defconfig
```kconfig
# Default Kconfig configuration for Raspberry Pi Pico (RP2040)
CONFIG_BOARD_RPI_PICO=y
CONFIG_SOC_RP2040=y
CONFIG_ARCH_ARM=y
CONFIG_CPU_CORTEX_M0PLUS=y

# System clock
CONFIG_SYS_CLOCK_HZ=1000

# Kernel features
CONFIG_KERNEL_PREEMPT_ENABLED=y
CONFIG_NUM_PRIORITIES=32
CONFIG_TIMESLICE_MS=10
CONFIG_TICKLESS_IDLE=y
CONFIG_SMP=n
CONFIG_HEAP_MEM=y
CONFIG_HEAP_SIZE=8192
CONFIG_STACK_CANARY=y
CONFIG_TLS=y
CONFIG_SCHED_DYNAMIC_PRIORITY=y

# Drivers
CONFIG_UART=y
CONFIG_GPIO=y
CONFIG_SPI=n
CONFIG_I2C=n
CONFIG_ADC=n
CONFIG_FLASH=n
CONFIG_TIMER_HW=n
CONFIG_RTC=n
CONFIG_WATCHDOG=n

# Subsystems
CONFIG_SHELL=y
CONFIG_LOG=y
CONFIG_LOG_DEFAULT_LEVEL=2
CONFIG_LOG_BACKEND_UART=y
CONFIG_LOG_DEFERRED=n
```

## boards/arm/rpi_pico2/Kconfig.board
```kconfig
config BOARD_RPI_PICO2
    bool "Raspberry Pi Pico 2"
    select SOC_RP2350
    help
      Raspberry Pi Pico 2 board based on the RP2350 microcontroller.
      Features: 2MB QSPI flash, USB, 26 GPIO pins, hardware FPU, TrustZone.
```

## boards/arm/rpi_pico2/rpi_pico2_defconfig
```kconfig
# Default Kconfig configuration for Raspberry Pi Pico 2 (RP2350)
CONFIG_BOARD_RPI_PICO2=y
CONFIG_SOC_RP2350=y
CONFIG_ARCH_ARM=y
CONFIG_CPU_CORTEX_M33=y
CONFIG_HAS_FPU=y
CONFIG_HAS_MPU=y

# System clock
CONFIG_SYS_CLOCK_HZ=1000

# Kernel features
CONFIG_KERNEL_PREEMPT_ENABLED=y
CONFIG_NUM_PRIORITIES=32
CONFIG_TIMESLICE_MS=10
CONFIG_TICKLESS_IDLE=y
CONFIG_SMP=n
CONFIG_HEAP_MEM=y
CONFIG_HEAP_SIZE=16384
CONFIG_STACK_CANARY=y
CONFIG_TLS=y
CONFIG_SCHED_DYNAMIC_PRIORITY=y

# Drivers
CONFIG_UART=y
CONFIG_GPIO=y
CONFIG_SPI=n
CONFIG_I2C=n
CONFIG_ADC=n
CONFIG_FLASH=n
CONFIG_TIMER_HW=n
CONFIG_RTC=n
CONFIG_WATCHDOG=n

# Subsystems
CONFIG_SHELL=y
CONFIG_LOG=y
CONFIG_LOG_DEFAULT_LEVEL=2
CONFIG_LOG_BACKEND_UART=y
CONFIG_LOG_DEFERRED=n
```

## drivers/Kconfig
```kconfig
# drivers/Kconfig — Driver subsystem

menu "Device Drivers"

source "drivers/gpio/Kconfig"
source "drivers/uart/Kconfig"
source "drivers/spi/Kconfig"
source "drivers/i2c/Kconfig"
source "drivers/timer/Kconfig"
source "drivers/adc/Kconfig"
source "drivers/flash/Kconfig"
source "drivers/rtc/Kconfig"
source "drivers/watchdog/Kconfig"

endmenu
```

## drivers/adc/Kconfig
```kconfig
config ADC
    bool "ADC driver"
    default n
    help
      Enable ADC (Analog-to-Digital Converter) driver.
      RP2040: 12-bit SAR ADC, 4 channels + temp sensor (base 0x4004C000).
```

## drivers/flash/Kconfig
```kconfig
config FLASH
    bool "Flash driver"
    default n
    help
      Enable internal flash read/write/erase driver.
      On RP2040/RP2350: operates via XIP SSI (execute-in-place) peripheral.
```

## drivers/gpio/Kconfig
```kconfig
config GPIO
    bool "GPIO driver"
    default y
    help
      Enable the GPIO (General Purpose Input/Output) driver.
      Provides pin direction, read, write, and interrupt configuration.
```

## drivers/i2c/Kconfig
```kconfig
config I2C
    bool "I2C driver"
    default n
    help
      Enable I2C (Inter-Integrated Circuit) driver. Supports master mode.
```

## drivers/rtc/Kconfig
```kconfig
config RTC
    bool "RTC driver"
    default n
    help
      Enable Real-Time Clock driver.
      RP2040: has a built-in RTC peripheral (base 0x4005C000).
```

## drivers/spi/Kconfig
```kconfig
config SPI
    bool "SPI driver"
    default n
    help
      Enable SPI (Serial Peripheral Interface) driver.
```

## drivers/timer/Kconfig
```kconfig
config TIMER_HW
    bool "Hardware timer / PWM driver"
    default n
    help
      Enable hardware timer and PWM driver.
      On RP2040: uses the PWM slice hardware (8 slices, 2 channels each).
```

## drivers/uart/Kconfig
```kconfig
config UART
    bool "UART driver"
    default y
    help
      Enable UART (Universal Asynchronous Receiver/Transmitter) driver.
      Required for the logging backend and debug shell.

config UART_INTERRUPT_DRIVEN
    bool "Interrupt-driven UART"
    default y
    depends on UART
    help
      Use interrupt-driven UART RX/TX instead of polling.
      Improves throughput at the cost of IRQ overhead.
```

## drivers/watchdog/Kconfig
```kconfig
config WATCHDOG
    bool "Watchdog timer driver"
    default n
    help
      Enable hardware watchdog timer driver.
      RP2040: Watchdog peripheral base 0x40058000, 24-bit countdown, 1us resolution.
```

## kernel/Kconfig
```kconfig
menu "Kernel Configuration"

config KERNEL_PREEMPT_ENABLED
    bool "Enable preemptive scheduling"
    default y
    help
      When enabled, a higher-priority thread can preempt a lower-priority
      one at any preemption point (system call, timer tick, IPI).
      Disable only for cooperative scheduling.

config NUM_PRIORITIES
    int "Number of thread priority levels"
    default 32
    range 2 64
    help
      Total number of distinct priority levels (0 = lowest, N-1 = highest).
      Each level has its own run queue. A larger value increases RAM usage
      slightly but provides finer scheduling granularity.

config TIMESLICE_MS
    int "Time-slice duration in milliseconds (round-robin)"
    default 10
    range 1 1000
    depends on KERNEL_PREEMPT_ENABLED
    help
      For threads at the same priority, the scheduler performs round-robin
      with this time slice. Set to 0 to disable time-slicing.

config TICKLESS_IDLE
    bool "Enable tickless idle (dynamic tick)"
    default y
    help
      When the system is idle, suppresses periodic tick interrupts and
      programs the hardware timer to wake up only for the next scheduled
      event. Reduces power consumption significantly.

config SMP
    bool "Symmetric Multi-Processing (SMP) support"
    default n
    help
      Enable SMP support for multi-core processors (e.g., RP2350 dual-core
      Cortex-M33). Adds per-CPU data structures and IPI (inter-processor
      interrupt) for cross-core reschedule.

config SMP_NUM_CPUS
    int "Number of CPUs"
    default 2
    range 2 4
    depends on SMP
    help
      Number of CPU cores to use. Must match the actual hardware.

config STACK_CANARY
    bool "Enable stack overflow canary detection"
    default y
    help
      Places a magic value (canary) at the bottom of each thread stack.
      The kernel checks the canary on context switch; if corrupted, a
      fatal error is triggered. Small overhead in exchange for safety.

config TLS
    bool "Enable thread-local storage (TLS)"
    default y
    help
      Allocates a small per-thread data block (TLS) within each thread's
      stack region. Used by subsystems like logging for per-thread state.

config SCHED_DYNAMIC_PRIORITY
    bool "Enable dynamic priority switching"
    default y
    help
      Allows threads to change their own or another thread's priority at
      runtime with vibe_thread_set_priority(). Required for priority
      inheritance in mutexes.

config IDLE_STACK_SIZE
    int "Idle thread stack size in bytes"
    default 256
    range 128 2048
    help
      Stack size for the per-CPU idle thread.

config SYS_WORKQ_STACK_SIZE
    int "System work queue thread stack size in bytes"
    default 1024
    range 512 8192
    help
      Stack size for the system work queue worker thread.

config SYS_WORKQ_PRIORITY
    int "System work queue thread priority"
    default 30
    range 0 31
    help
      Priority of the system work queue worker thread.

endmenu
```

## lib/Kconfig
```kconfig
menu "Libraries"

source "lib/heap/Kconfig"
source "lib/ring_buffer/Kconfig"
source "lib/async/Kconfig"
source "lib/job_scheduler/Kconfig"

endmenu
```

## lib/async/Kconfig
```kconfig
menu "Async / Coroutines"

config ASYNC
    bool "Enable stackless coroutine (async/await) support"
    default y
    help
      Provides ASYNC_BEGIN / ASYNC_END / ASYNC_YIELD / ASYNC_AWAIT /
      ASYNC_AWAIT_CORO macros for writing stackless cooperative coroutines
      in C.

      Each coroutine is a plain C function that stores its resume point in
      a small async_t struct — no extra stack is required.  Persistent state
      must live in a caller-supplied context struct.

      Required by the job scheduler (CONFIG_JOB_SCHEDULER).  Can also be
      used directly in application code without the scheduler.

endmenu
```

## lib/heap/Kconfig
```kconfig
menu "Heap Allocator"

config HEAP_MEM
    bool "Enable dynamic heap memory allocator"
    default y
    help
      Enables vibe_heap_alloc() / vibe_heap_free() backed by a statically
      reserved heap region. The heap size is set by CONFIG_HEAP_SIZE.
      Disable to eliminate the heap entirely and save RAM.

config HEAP_SIZE
    int "Heap size in bytes"
    default 4096
    range 256 131072
    depends on HEAP_MEM
    help
      Size of the heap region in bytes. Must fit within available RAM after
      the kernel, stack, and static data are placed.
      Common values: 4096 (4 KB), 8192 (8 KB), 16384 (16 KB).

choice HEAP_ALLOCATOR
    prompt "Heap allocator algorithm"
    depends on HEAP_MEM
    default HEAP_ALLOCATOR_TLSF
    help
      Select the allocation algorithm used by vibe_heap_alloc() / vibe_malloc().

config HEAP_ALLOCATOR_TLSF
    bool "TLSF — Two-Level Segregated Fit (O(1) real-time)"
    help
      O(1) allocation and free. Uses a two-level bitmap to locate a suitable
      free block in constant time, with no loops or searching. Best choice for
      hard real-time systems or when allocation latency must be bounded.
      Control structure overhead: ~700 bytes (independent of heap size).

config HEAP_ALLOCATOR_BEST_FIT
    bool "Best Fit (O(n), lowest fragmentation)"
    help
      Scans all free blocks and picks the smallest one that fits the request.
      Minimises wasted space per allocation but requires a full list walk.
      Good when fragmentation matters more than allocation latency.

config HEAP_ALLOCATOR_FIRST_FIT
    bool "First Fit (O(n), lowest overhead)"
    help
      Returns the first free block large enough to satisfy the request.
      Simplest algorithm, lowest code size. Suitable for systems with
      predictable allocation patterns or very small heaps.

endchoice

config HEAP_STATS
    bool "Enable heap statistics"
    default y
    depends on HEAP_MEM
    help
      Enables vibe_heap_stats() to return live allocation metrics:
      total/used/free bytes, largest free block, alloc/free block counts.
      When disabled, vibe_heap_stats() fills the struct with zeros and
      the block-chain walk is omitted, saving cycles on every query.

config HEAP_CORRUPTION_CHECK
    bool "Enable heap corruption detection"
    default y
    depends on HEAP_MEM
    depends on !HEAP_ALLOCATOR_TLSF
    help
      Verifies magic values in block headers on every vibe_heap_free() to
      detect double-frees and out-of-bounds writes. Adds one comparison per
      free call and prints a diagnostic if corruption is detected.
      Not applicable to the TLSF backend (TLSF uses its own size-flag checks).
      Disable to remove the check on performance-critical paths.

endmenu
```
