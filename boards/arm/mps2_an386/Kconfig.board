## boards/arm/mps2_an386/Kconfig.board
```kconfig
config BOARD_MPS2_AN386
    bool "ARM MPS2 AN386 (QEMU emulation)"
    select SOC_MPS2_AN386
    help
      ARM MPS2 FPGA board with the AN386 Cortex-M4 image. This is the
      board VibeRTOS targets for QEMU emulation (`-M mps2-an386`):
      4MB code SRAM at 0x0, 4MB data SRAM at 0x20000000, CMSDK UART
      console, semihosting exit for automated test runs.
```

## soc/arm/arm/mps2_an386/Kconfig.soc
```kconfig
config SOC_MPS2_AN386
    bool "ARM MPS2 AN386 (Cortex-M4)"
    select CPU_CORTEX_M4
    help
      ARM MPS2 FPGA prototyping board loaded with the AN386 DesignStart
      Cortex-M4 image. Emulated by QEMU as machine `mps2-an386` — this is
      the SoC VibeRTOS uses for emulation-based testing.

if SOC_MPS2_AN386

config SOC_HAS_FPU
    bool
    default y        # Cortex-M4F (VibeRTOS builds soft-float by default)

config SOC_FLASH_SIZE
    int
    default 4194304  # 4MB ZBT SSRAM1 at 0x00000000 (code, acts as flash)

config SOC_RAM_SIZE
    int
    default 4194304  # 4MB ZBT SSRAM2/3 at 0x20000000 (data)

config SOC_NUM_CORES
    int
    default 1        # Single-core Cortex-M4

endif # SOC_MPS2_AN386
```

## subsys/rtt/Kconfig
```kconfig
menu "RTT (Real-Time Transfer)"

config RTT
    bool "Enable RTT debugger I/O channels"
    default n
    help
      SEGGER-RTT-compatible target->host / host->target ring buffers in
      RAM, drained by the debug probe over SWD. Works with J-Link RTT
      Viewer, OpenOCD (`rtt setup/start`), and pyOCD without any target
      protocol. Non-blocking: output is dropped when the host is not
      attached, so timing stays deterministic.

if RTT

config RTT_BUFFER_SIZE_UP
    int "Up buffer (target -> host) size in bytes"
    default 1024
    range 64 65536
    help
      Ring buffer size for channel 0 ("Terminal") output. Larger buffers
      tolerate slower host polling without dropping data.

config RTT_BUFFER_SIZE_DOWN
    int "Down buffer (host -> target) size in bytes"
    default 64
    range 16 4096
    help
      Ring buffer size for channel 0 input (host keystrokes / commands).

config RTT_MAX_UP_BUFFERS
    int "Maximum number of up buffers"
    default 2
    range 1 8
    help
      Slots in the control block for target->host channels. Channel 0 is
      the Terminal; extra slots are for a future trace library (e.g.
      SystemView uses its own channel).

config RTT_MAX_DOWN_BUFFERS
    int "Maximum number of down buffers"
    default 2
    range 1 8

config RTT_CONSOLE
    bool "Route the kernel console (vibe_printk) to RTT"
    default n
    help
      Provides a strong vibe_console_putc() that writes to RTT channel 0.
      Mutually exclusive with a board/SoC console that also overrides
      vibe_console_putc (the link will fail if both are enabled).

endif # RTT

endmenu
```
