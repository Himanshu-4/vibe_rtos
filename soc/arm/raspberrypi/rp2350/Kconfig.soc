## soc/arm/raspberrypi/rp2350/Kconfig.soc
```kconfig
config SOC_RP2350
    bool "Raspberry Pi RP2350"
    select CPU_CORTEX_M33
    help
      RP2350 quad-core SoC by Raspberry Pi Ltd (2x Cortex-M33 + 2x RISC-V Hazard3).
      Used on the Raspberry Pi Pico 2 board.

if SOC_RP2350

config SOC_HAS_FPU
    bool
    default y

config SOC_FLASH_SIZE
    int
    default 2097152   # 2MB (external QSPI flash)

config SOC_RAM_SIZE
    int
    default 524288    # 520KB (16 banks of 64KB each, minus XIP cache)

config SOC_NUM_CORES
    int
    default 2         # 2 Cortex-M33 (RISC-V cores ignored for now)

config SOC_HAS_TRUSTZONE
    bool
    default y         # Cortex-M33 includes TrustZone

endif # SOC_RP2350
```

## subsys/Kconfig
```kconfig
# subsys/Kconfig — Optional subsystems

menu "Subsystems"

source "subsys/shell/Kconfig"
source "subsys/logging/Kconfig"
source "subsys/coredump/Kconfig"

endmenu
```

## subsys/coredump/Kconfig
```kconfig
config COREDUMP
    bool "Coredump subsystem"
    default n
    help
      Enable the VibeRTOS coredump subsystem.
      On a fault (HardFault, MemManage, BusFault, UsageFault, assert, or
      stack overflow) the CPU state is captured and stored in a .noinit
      RAM region that survives a warm reset.
      After reboot, call vibe_coredump_dump() or run the "coredump" shell
      command to inspect the saved state.

config COREDUMP_STACK_SIZE
    int "Stack snapshot size in bytes"
    default 128
    range 32 512
    depends on COREDUMP
    help
      Number of stack bytes captured near the fault point and stored
      in the coredump record.  Larger values give more context but
      consume more .noinit RAM.

config COREDUMP_SHELL
    bool "Register 'coredump' shell command"
    default y
    depends on COREDUMP && SHELL
    help
      Register the built-in "coredump" and "coredump clear" shell
      commands so the stored coredump can be inspected interactively.
```

## subsys/logging/Kconfig
```kconfig
config LOG
    bool "Logging subsystem"
    default y
    help
      Enable the VibeRTOS levelled logging subsystem.

config LOG_DEFAULT_LEVEL
    int "Default global log level (0=ERR 1=WRN 2=INF 3=DBG)"
    default 2
    range 0 3
    depends on LOG

config LOG_BACKEND_UART
    bool "UART logging backend"
    default y
    depends on LOG && UART
    help
      Output log messages over UART.

config LOG_BACKEND_RTT
    bool "RTT (SEGGER Real-Time Transfer) logging backend"
    default n
    depends on LOG
    help
      Output log messages via SEGGER RTT (requires RTT library).

config LOG_DEFERRED
    bool "Deferred (asynchronous) logging"
    default n
    depends on LOG
    help
      Buffer log messages in a ring buffer and flush from a dedicated
      low-priority thread. Reduces latency impact of logging on time-
      critical threads.

config LOG_BUFFER_SIZE
    int "Deferred log ring buffer size in bytes"
    default 1024
    range 256 16384
    depends on LOG && LOG_DEFERRED
```

## subsys/shell/Kconfig
```kconfig
config SHELL
    bool "Interactive serial shell"
    default n
    help
      Enable the VibeRTOS interactive serial shell.
      Provides a UART command-line interface for debugging and control.

config SHELL_PROMPT_STR
    string "Shell prompt string"
    default "vibe> "
    depends on SHELL

config SHELL_MAX_ARGS
    int "Maximum number of shell command arguments"
    default 8
    range 2 32
    depends on SHELL

config SHELL_BUF_SIZE
    int "Shell input line buffer size in bytes"
    default 128
    range 32 512
    depends on SHELL
```
